## conf/machine/duovero.conf
```bitbake
#@TYPE: Machine
#@NAME: duovero
#@DESCRIPTION: Machine configuration for the Gumstix duovero

require conf/machine/include/duovero-jumpnow.inc

EXTRA_IMAGEDEPENDS += "u-boot"

PREFERRED_PROVIDER_virtual/bootloader = "u-boot"
UBOOT_MACHINE = "omap4_duovero_config"

PREFERRED_PROVIDER_virtual/kernel = "linux-gumstix"

IMAGE_FSTYPES += "tar.xz"

SERIAL_CONSOLE = "115200 ttyO2"

MACHINE_FEATURES = "kernel26 alsa ext3 screen usbgadget usbhost uboot vfat"
```

## conf/machine/include/duovero-jumpnow.inc
```bitbake
SOC_FAMILY = "omap4"
require conf/machine/include/soc-family.inc

TARGET_ARCH = "arm"

#DEFAULTTUNE ?= "cortexa9hf-neon"

#change below to a9 if you are building omap4 only images
require conf/machine/include/tune-cortexa9.inc

# Increase this everytime you change something in the kernel
MACHINE_KERNEL_PR = "r0"

KERNEL_IMAGETYPE = "uImage"

UBOOT_ENTRYPOINT = "0x80008000"
UBOOT_LOADADDRESS = "0x80008000"
```

## conf/machine/overo.conf
```bitbake
#@TYPE: Machine
#@NAME: Overo machine
#@DESCRIPTION: Machine configuration for the Gumstix Overo

require conf/machine/include/overo-jumpnow.inc

EXTRA_IMAGEDEPENDS += "u-boot"

PREFERRED_PROVIDER_virtual/bootloader = "u-boot"
UBOOT_MACHINE = "omap3_overo_config"

PREFERRED_PROVIDER_virtual/kernel = "linux-gumstix"

IMAGE_FSTYPES += "tar.xz"

SERIAL_CONSOLE = "115200 ttyO2"

MACHINE_FEATURES = "kernel26 alsa ext3 screen usbgadget usbhost uboot vfat"
```
